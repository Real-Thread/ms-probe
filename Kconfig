## Kconfig
```kconfig
menuconfig PKG_USING_MS_PROBE
    bool "ms-probe: Microscope embedded diagnostic components"
    select RT_USING_MICROSCOPE
    default n
    help
        GPL-2.0 / commercial dual-licensed development diagnostics.
        Scope, backtrace and coredump are configured below.
        Disable this package and Fault injection in production builds.

if PKG_USING_MS_PROBE

config PKG_MS_PROBE_PATH
    string
    default "/packages/tools/ms-probe"

choice
    prompt "Version"
    default PKG_USING_MS_PROBE_LATEST_VERSION

config PKG_USING_MS_PROBE_LATEST_VERSION
    bool "latest"

endchoice

config PKG_MS_PROBE_VER
    string
    default "latest" if PKG_USING_MS_PROBE_LATEST_VERSION

endif

rsource "Kconfig.options"
```

## Kconfig.options
```kconfig
menu "Microscope"

config RT_USING_MICROSCOPE
    bool "Enable Microscope diagnostic components"
    default y if PKG_USING_MS_PROBE
    default n
    help
        Development-only diagnostic components. Disable these components,
        Scope and Fault injection in production configurations.

if RT_USING_MICROSCOPE

rsource "coredump/Kconfig"
rsource "backtrace/Kconfig"

menuconfig RT_USING_SCOPE
    bool "Enable Microscope Scope probe"
    depends on RT_USING_MICROSCOPE
    default n
    help
        Enable the read-only Microscope Scope diagnostic probe.

if RT_USING_SCOPE

config RT_SCOPE_MAX_PAYLOAD
    int "Maximum protocol payload"
    range 64 1020
    default 256

config RT_SCOPE_MAX_READ_LENGTH
    int "Maximum bytes per read request"
    range 1 1048576
    default 4096

config RT_SCOPE_FRAME_TIMEOUT_MS
    int "Incomplete frame idle timeout in milliseconds"
    range 10 10000
    default 250
    help
        Reset the byte-stream parser after an incomplete frame remains idle
        for this duration. The Fault runner uses the platform monotonic timer,
        so recovery does not depend on an OS tick or timer interrupt.

rsource "ports/Kconfig"

endif

endif

endmenu
```

## backtrace/Kconfig
```kconfig
menuconfig RT_USING_STACK_BACKTRACE
    bool "Enable stack backtrace"
    depends on RT_USING_MICROSCOPE
    default n
    help
        Capture and print stack backtraces through a common microscope API.
        An architecture port must provide the stack unwind implementation.

if RT_USING_STACK_BACKTRACE

config RT_STACK_BACKTRACE_DEPTH_MAX
    int "Maximum stack backtrace depth"
    range 1 64
    default 8

endif
```

## coredump/Kconfig
```kconfig
# Enable CoreDump.
config RT_USING_COREDUMP
    bool "Enable CoreDump support"
    default n
    help
        Enable the CoreDump feature to capture crash information for debugging.

# CoreDump related configuration menu.
menu "CoreDump Configuration"
    depends on RT_USING_COREDUMP

    # Target architecture selection.
    choice
        prompt "Target architecture for CoreDump"
        default RT_COREDUMP_ARCH_ARMV7M
        help
            Select the target architecture for CoreDump support.

        config RT_COREDUMP_ARCH_TRICORE
            bool "TriCore architecture"
            help
                Enable CoreDump for the TriCore architecture (e.g. Infineon TC2XX/TC3XX).

        config RT_COREDUMP_ARCH_ARMV7M
            bool "ARMv7-M architecture"
            help
                Enable CoreDump for the ARMv7-M architecture (e.g., Cortex-M3/M4/M7).

        config RT_COREDUMP_ARCH_AARCH64
            bool "AArch64 architecture"
            help
                Enable CoreDump for the AArch64 architecture (e.g., Cortex-A53/A72).

    endchoice

    # Test cases for CoreDump.
    config RT_USING_COREDUMP_TESTCASE
        bool "Enable CoreDump test cases"
        default n
        help
            Enable test cases to verify CoreDump functionality.

endmenu
```

## ports/Kconfig
```kconfig
if SOC_STM32F407ZG
rsource "stm32f407-rt-spark/Kconfig"
endif

if SOC_QEMU_MPS3_AN536
rsource "qemu-mps3-an536/Kconfig"
endif

if SOC_KF32A158
rsource "kf32a158-evb/Kconfig"
endif

if SOC_FAMILY_S32K3
rsource "s32k3-core/Kconfig"
endif
```

## ports/kf32a158-evb/Kconfig
```kconfig
config RT_SCOPE_KF32A158_PORT
    bool
    default y
    select BSP_USING_UART
    select BSP_USING_UART0
    help
        This development-only port exclusively takes NMI, HardFault,
        StackFault, AriFault, SRAM/DPRAM/Cache/Flash ECC and BUS Fault into
        ms-probe. The current port accepts RT_CPUS_NR=1 only; multi-core
        builds fail at compile time.

config RT_SCOPE_DEVICE_ID
    hex "Microscope Scope device ID"
    default 0x0000A158

config RT_SCOPE_EMERGENCY_STACK_SIZE
    int "Microscope Scope emergency stack size"
    range 1024 4096
    default 2048
    help
        The stack and all Probe state must fit the reserved 8 KiB Scope
        workspace. The linker rejects configurations which exceed it.

config RT_SCOPE_READ_REGION_START
    hex
    default 0x10000000

config RT_SCOPE_READ_REGION_SIZE
    hex
    default 0x0002E000

config RT_SCOPE_SECONDARY_READ_REGION_START
    hex
    default 0x10030000

config RT_SCOPE_SECONDARY_READ_REGION_SIZE
    hex
    default 0x00010000

config RT_SCOPE_TERTIARY_READ_REGION_START
    hex
    default 0x00000000

config RT_SCOPE_TERTIARY_READ_REGION_SIZE
    hex
    default 0x00200000

config RT_SCOPE_USING_FAULT_INJECTION
    bool "Enable unsafe Scope Fault injection command"
    depends on RT_SCOPE_KF32A158_PORT && RT_USING_MSH
    default n
    help
        Export the fault_test command for diagnostic verification. This
        command deliberately raises HardFault and must remain disabled in
        production configurations.
```

## ports/qemu-mps3-an536/Kconfig
```kconfig
config RT_SCOPE_QEMU_MPS3_AN536_PORT
    bool
    default y

config RT_SCOPE_DEVICE_ID
    hex "Microscope Scope device ID"
    default 0x0000A536

config RT_SCOPE_EMERGENCY_STACK_SIZE
    int "Microscope Scope emergency stack size"
    range 1024 2048
    default 1024
    help
        Stack and all Probe state must fit the BSP's 4 KiB reserved Scope
        workspace. The linker rejects configurations which exceed it.

config RT_SCOPE_READ_REGION_START
    hex
    default 0x20000000

config RT_SCOPE_READ_REGION_SIZE
    hex
    default 0x00100000

config RT_SCOPE_SECONDARY_READ_REGION_START
    hex
    default 0x10000000

config RT_SCOPE_SECONDARY_READ_REGION_SIZE
    hex
    default 0x00080000

config RT_SCOPE_TERTIARY_READ_REGION_START
    hex
    default 0x08000000

config RT_SCOPE_TERTIARY_READ_REGION_SIZE
    hex
    default 0x00800000

config RT_SCOPE_USING_FAULT_INJECTION
    bool "Enable unsafe Scope fault injection command"
    depends on RT_USING_MSH
    default n
    help
        Export the msfault command for diagnostic verification. This command
        intentionally triggers a processor exception and must remain disabled
        in production configurations.

if RT_SCOPE_USING_FAULT_INJECTION

config RT_SCOPE_FAULT_INJECTION_ADDRESS
    hex "Fault injection address"
    default 0xFFFFFFF0
    help
        Address read by msfault data-abort. It must be unmapped on the target.

endif
```

## ports/s32k3-core/Kconfig
```kconfig
config RT_SCOPE_S32K3_PORT
    bool
    default y
    select BSP_USING_UART

choice
    prompt "Microscope Scope Fault transport"
    default RT_SCOPE_S32K3_UART3 if BOARD_S32K3X4_EVB
    default RT_SCOPE_S32K3_UART0

config RT_SCOPE_S32K3_UART0
    bool "LPUART0 (VCU/core PA27/PA28)"
    select BSP_USING_UART0

config RT_SCOPE_S32K3_UART3
    bool "LPUART3 (EVB PD2/PD3)"
    select BSP_USING_UART3

endchoice

config RT_SCOPE_DEVICE_ID
    hex "Microscope Scope device ID"
    default 0x00000344

config RT_SCOPE_EMERGENCY_STACK_SIZE
    int "Microscope Scope emergency stack size"
    range 1024 4096
    default 2048
    help
        The stack and all Probe state must fit the reserved 8 KiB
        Scope workspace. The linker rejects configurations which
        exceed it.

config RT_SCOPE_READ_REGION_START
    hex
    default 0x00400000

config RT_SCOPE_READ_REGION_SIZE
    hex
    default 0x003CE000

config RT_SCOPE_SECONDARY_READ_REGION_START
    hex
    default 0x20400000

config RT_SCOPE_SECONDARY_READ_REGION_SIZE
    hex
    default 0x0004E000

config RT_SCOPE_TERTIARY_READ_REGION_START
    hex
    default 0x20000000

config RT_SCOPE_TERTIARY_READ_REGION_SIZE
    hex
    default 0x00020000

config RT_SCOPE_S32K3_FOURTH_READ_REGION_START
    hex
    default 0x00000000

config RT_SCOPE_S32K3_FOURTH_READ_REGION_SIZE
    hex
    default 0x00010000

config RT_SCOPE_S32K3_FIFTH_READ_REGION_START
    hex
    default 0x10000000

config RT_SCOPE_S32K3_FIFTH_READ_REGION_SIZE
    hex
    default 0x00010000

config RT_SCOPE_S32K3_TAKE_MEMMANAGE
    bool "Route MemManage Fault to Microscope Scope"
    default n
    help
        This bypasses the existing RT-Thread MPU recovery path.
        Enable it only when every MemManage Fault is terminal.

config RT_SCOPE_USING_FAULT_INJECTION
    bool "Enable unsafe Scope Fault injection command"
    depends on RT_USING_MSH
    default n
    help
        Export the msfault command for diagnostic verification. This
        command intentionally executes an undefined instruction and
        must remain disabled in production configurations.
```

## ports/stm32f407-rt-spark/Kconfig
```kconfig
config RT_SCOPE_STM32F407_PORT
    bool
    default y
    select BSP_USING_USB_TO_USART

config RT_SCOPE_DEVICE_ID
    hex "Microscope Scope device ID"
    default 0x00000413

config RT_SCOPE_EMERGENCY_STACK_SIZE
    int "Microscope Scope emergency stack size"
    range 1024 3072
    default 2048
    help
        The stack and all Probe state must fit the BSP's reserved 8 KiB
        Scope workspace. The GNU linker rejects configurations which exceed it.

config RT_SCOPE_READ_REGION_START
    hex
    default 0x20000000

config RT_SCOPE_READ_REGION_SIZE
    hex
    default 0x0001E000

config RT_SCOPE_SECONDARY_READ_REGION_START
    hex
    default 0x10000000

config RT_SCOPE_SECONDARY_READ_REGION_SIZE
    hex
    default 0x00010000

config RT_SCOPE_TERTIARY_READ_REGION_START
    hex
    default 0x08000000

config RT_SCOPE_TERTIARY_READ_REGION_SIZE
    hex
    default 0x00100000

config RT_SCOPE_STM32_SERVICE_IWDG
    bool "Service IWDG in Microscope Scope Fault mode"
    default y
    help
        Reload IWDG on every Probe polling iteration. This does not start IWDG.
        WWDG and external watchdogs require a separate board policy.

config RT_SCOPE_STM32_TAKE_MEMMANAGE
    bool "Route MemManage Fault to Microscope Scope"
    default n
    help
        This bypasses the existing RT-Thread OSA/MPU MemManage recovery path.
        Enable it only when every MemManage Fault is terminal.

config RT_SCOPE_USING_FAULT_INJECTION
    bool "Enable unsafe Scope Fault injection command"
    depends on RT_USING_MSH
    default n
    help
        Export the msfault command for diagnostic verification. This command
        intentionally executes an undefined instruction and must remain
        disabled in production configurations.
```

## tests/qemu-vexpress-a9/defconfig
```kconfig
CONFIG_RT_NAME_MAX=16
CONFIG_RT_ALIGN_SIZE=8
CONFIG_RT_THREAD_PRIORITY_256=y
CONFIG_RT_TICK_PER_SECOND=100
CONFIG_RT_USING_OVERFLOW_CHECK=y
CONFIG_RT_USING_HOOK=y
CONFIG_RT_USING_IDLE_HOOK=y
CONFIG_IDLE_THREAD_STACK_SIZE=4096
CONFIG_RT_USING_SEMAPHORE=y
CONFIG_RT_USING_MUTEX=y
CONFIG_RT_USING_SMALL_MEM=y
CONFIG_RT_USING_SMALL_MEM_AS_HEAP=y
CONFIG_RT_USING_HEAP=y
CONFIG_RT_USING_DEVICE=y
CONFIG_RT_USING_CONSOLE=y
CONFIG_RT_CONSOLE_DEVICE_NAME="uart0"
CONFIG_RT_USING_COMPONENTS_INIT=y
CONFIG_RT_USING_USER_MAIN=y
CONFIG_RT_MAIN_THREAD_STACK_SIZE=4096
CONFIG_RT_USING_MSH=y
CONFIG_RT_USING_FINSH=y
CONFIG_FINSH_THREAD_STACK_SIZE=4096
CONFIG_FINSH_USING_SYMTAB=y
CONFIG_RT_USING_SERIAL=y
CONFIG_RT_USING_SERIAL_V1=y
CONFIG_RT_USING_LEGACY=y
CONFIG_SOC_VEXPRESS_A9=y
CONFIG_BSP_USING_UART=y
CONFIG_BSP_USING_UART0=y
# CONFIG_RT_USING_SMART is not set
# CONFIG_RT_USING_SMP is not set
# CONFIG_RT_USING_DFS is not set
# CONFIG_RT_USING_LWIP is not set
# CONFIG_BSP_DRV_EMAC is not set
# CONFIG_BSP_USING_LVGL is not set
```
